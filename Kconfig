## Kconfig
```kconfig
mainmenu "DPA calc"
config  DONE
        bool
	default y
menu "Basic settings"

  config BATCH_SIZE 
	  int "How many samples should I process in a row?"
	  default 5
	  ---help---
	  5 for tests, in "real life" it should be much bigger
  config KEY_HYPOTESIS
	  int "How many bits of the key should I try to guess?"
	  default 3
  config KNOWNDATA_BITS
	  int "How large is the plain/ciphertext? (bits)"
	  default 64
	  
  choice
	prompt "Matrix data type"
    config TRACETYPE_FLOAT
	    bool "Float"
    config TRACETYPE_DOUBLE
	    bool "Double"
  endchoice
endmenu
menu "Compilation options"
  choice
	prompt "Build type"
    config BUILD_DEBUG
	    bool "Debug"
    config BUILD_RELEASE
	    bool "Release"
  endchoice

config DEBUG_OPTIONS
	  string "Debug options"
	  default "-O0 -g"
	  depends on BUILD_DEBUG
	  
config OPTIMIZATION_OPTIONS
	  string "Optimization options"
	  default "-O2 -march=native"
	  depends on BUILD_RELEASE

endmenu
menu "Class choices"  
  
 
config CLASS_INPUT
	  string "Name of the class that parses the input file"
	  default "bin1"
  
config CLASS_KEYGEN
	  string "Name of the class that associates key index to real key value"
	  default "keygen1"
  
config CLASS_INTERMEDIATE
	  string "Name of the class that computes the intermediate value"
	  default "int1"
  
config CLASS_POWERMODEL
	  string "Name of the class that computes the power model"
	  default "pm1"

config CLASS_STATISTIC
	  string "Name of the class that computes statistic tests"
	  default "pearson"

config CLASS_EXEC
	  string "Name of the class that manages threads"
	  default "seq_monocore"

config CLASS_OUTPUT
	  string "Name of the class that writes output data"
	  default "gnuplot"
 
endmenu
```
